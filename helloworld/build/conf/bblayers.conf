## helloworld/mylayer/conf/layer.conf
```bitbake
BBPATH .= ":${LAYERDIR}"

# BBFILES: List of recipe files BitBake uses to build software.
BBFILES += "${LAYERDIR}/*.bb"

# BBFILE_COLLECTIONS: Lists the names of configured layers. These names are used to find the other BBFILE_* variables. Typically, each layer appends its name to this variable in its conf/layer.conf file.
BBFILE_COLLECTIONS += "mylayer"
# BBFILE_PATTERN: Variable that expands to match files from BBFILES in a particular layer. This variable is used in the conf/layer.conf file and must be suffixed with the name of the specific layer (e.g. BBFILE_PATTERN_emenlow).
BBFILE_PATTERN_mylayer := "^${LAYERDIR}/"
```
